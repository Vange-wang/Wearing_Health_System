## Code文档/固件/box3_voice_agent/sdkconfig.defaults
```kconfig
CONFIG_IDF_TARGET="esp32s3"

CONFIG_ESP_SYSTEM_PANIC_PRINT_HALT=y

CONFIG_ESP_CONSOLE_USB_SERIAL_JTAG=y

CONFIG_ESP32S3_DATA_CACHE_64KB=y
CONFIG_ESP32S3_DATA_CACHE_LINE_64B=y
CONFIG_ESP32S3_INSTRUCTION_CACHE_32KB=y
CONFIG_ESP32S3_SPIRAM_SUPPORT=y

CONFIG_ESPTOOLPY_FLASHMODE_QIO=y
CONFIG_ESPTOOLPY_FLASHSIZE_16MB=y

CONFIG_LV_COLOR_16_SWAP=y
# 83 == 'S'
CONFIG_LV_FS_POSIX_LETTER=83
CONFIG_LV_USE_CLIB_MALLOC=y
CONFIG_LV_CACHE_DEF_SIZE=524288
CONFIG_LV_IMAGE_HEADER_CACHE_DEF_CNT=8
CONFIG_LV_USE_BMP=y
CONFIG_LV_USE_FS_POSIX=y
CONFIG_LV_USE_GIF=y
CONFIG_LV_USE_LODEPNG=y
CONFIG_LV_USE_LOG=y
CONFIG_LV_LOG_LEVEL_WARN=y
CONFIG_LV_LOG_PRINTF=y

CONFIG_PARTITION_TABLE_CUSTOM=y

CONFIG_SPIRAM_MODE_OCT=y
CONFIG_SPIRAM_SPEED_80M=y
CONFIG_SPIRAM_USE_MALLOC=y

# BSP
CONFIG_BSP_LCD_DRAW_BUF_HEIGHT=10

# P2 BLE central（NimBLE，任务单 2026-08-23-P2-BOX3-BLEcentral）
CONFIG_BT_ENABLED=y
CONFIG_BT_NIMBLE_ENABLED=y
CONFIG_BT_NIMBLE_ROLE_CENTRAL=y
CONFIG_BT_NIMBLE_ROLE_PERIPHERAL=n
CONFIG_BT_NIMBLE_MAX_CONNECTIONS=1
CONFIG_BT_NIMBLE_NVS_PERSIST=y

# P2：MUTE 双击触发 BLE 扫描——双击判定窗口放宽到 500ms（默认 180ms 人手速不够）
CONFIG_BUTTON_SHORT_PRESS_TIME_MS=500
```

## Code文档/固件/wrist_node/sdkconfig.defaults
```kconfig
# 腕部节点（ESP32-C3）sdkconfig 默认值
CONFIG_IDF_TARGET="esp32c3"
CONFIG_BT_ENABLED=y
CONFIG_BT_NIMBLE_ENABLED=y
CONFIG_BT_NIMBLE_ROLE_PERIPHERAL=y
CONFIG_BT_NIMBLE_ROLE_CENTRAL=n
CONFIG_BT_NIMBLE_MAX_CONNECTIONS=2
CONFIG_BT_NIMBLE_NVS_PERSIST=0
CONFIG_BT_NIMBLE_SVC_GAP_DEVICE_NAME="WH-Wrist01"
CONFIG_BT_NIMBLE_SVC_GAP_APPEARANCE_WRITE_PERM=0
```
